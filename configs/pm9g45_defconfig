## configs/pm9g45_defconfig
```kconfig
# Architecture
BR2_arm=y
BR2_arm926t=y

# Linux headers same as kernel, a 6.6 series
BR2_PACKAGE_HOST_LINUX_HEADERS_CUSTOM_6_6=y

# Kernel
BR2_LINUX_KERNEL=y
BR2_LINUX_KERNEL_CUSTOM_GIT=y
BR2_LINUX_KERNEL_CUSTOM_REPO_URL="https://github.com/linux4microchip/linux.git"
BR2_LINUX_KERNEL_CUSTOM_REPO_VERSION="linux-6.6-mchp"
BR2_LINUX_KERNEL_DEFCONFIG="at91_dt"
BR2_LINUX_KERNEL_DTS_SUPPORT=y
BR2_LINUX_KERNEL_INTREE_DTS_NAME="microchip/pm9g45"
BR2_LINUX_KERNEL_PATCH="board/ronetix/pm9g45/0001-dts-microchip-pm9g45.dts-modify-partition-table.patch"

# Filesystem
BR2_TARGET_ROOTFS_UBIFS=y
BR2_TARGET_ROOTFS_UBIFS_MAXLEBCNT=2047
BR2_TARGET_ROOTFS_UBI=y

# Bootloaders
BR2_TARGET_AT91BOOTSTRAP3=y
BR2_TARGET_AT91BOOTSTRAP3_CUSTOM_GIT=y
BR2_TARGET_AT91BOOTSTRAP3_CUSTOM_REPO_URL="https://github.com/ronetix/at91bootstrap.git"
BR2_TARGET_AT91BOOTSTRAP3_CUSTOM_REPO_VERSION="at91bootstrap-3.10.4_rnx"
BR2_TARGET_AT91BOOTSTRAP3_DEFCONFIG="pm9g45_nf_uboot"

BR2_TARGET_UBOOT=y
BR2_TARGET_UBOOT_BUILD_SYSTEM_KCONFIG=y
BR2_TARGET_UBOOT_CUSTOM_GIT=y
BR2_TARGET_UBOOT_CUSTOM_REPO_URL="https://github.com/ronetix/u-boot.git"
BR2_TARGET_UBOOT_CUSTOM_REPO_VERSION="u-boot-2024.07-mchp"
BR2_TARGET_UBOOT_BOARD_DEFCONFIG="pm9g45"
```
